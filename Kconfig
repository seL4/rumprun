## Kconfig
```kconfig
#
# Copyright 2017, Data61
# Commonwealth Scientific and Industrial Research Organisation (CSIRO)
# ABN 41 687 119 230.
# This software may be distributed and modified according to the terms of
# the BSD 2-Clause license. Note that NO WARRANTY is provided.
# See "LICENSE_BSD2.txt" for details.
# @TAG(DATA61_BSD)
#

menuconfig RUMPRUN
    bool "rumprun"
    default y
    depends on HAVE_LIB_SEL4 && HAVE_LIBC && HAVE_LIB_SEL4_VKA && HAVE_LIB_SEL4_UTILS && \
               HAVE_LIB_SEL4_VSPACE && HAVE_LIB_SEL4_SIMPLE && HAVE_LIB_UTILS && HAVE_LIB_CPIO && \
               HAVE_LIB_ELF && HAVE_LIB_SEL4_MUSLC_SYS && HAVE_LIB_SEL4_ALLOCMAN && HAVE_LIB_PLATSUPPORT && \
               HAVE_LIB_SEL4_PLAT_SUPPORT
    select HAVE_RUMPRUN
    help
        Rumprun unikernel

config RUMPRUN_TMPFS_NUM_MiB
    int "Size of Rumprun tmpfs mount in MiB"
    default 1
    depends on RUMPRUN
    help
        Set this to the size of memory you want to back the tmpfs at /tmp

    menu "Set IOAPIC options"
        depends on RUMPRUN && IRQ_IOAPIC

        choice
            prompt "Select Ethernet IRQ handling"
            default USE_IOAPIC_ETH
            help
                Select IRQ handling for ethernet.

            config USE_IOAPIC_ETH
                bool "IOAPIC"
            config USE_MSI_ETH
                bool "MSI"
    endchoice
    endmenu

config HAVE_RUMPRUN
    bool
```
